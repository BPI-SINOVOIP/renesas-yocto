## meta-bananapi/meta-renesas-bsp/conf/machine/bananapi-ai2h.conf
```bitbake
#@TYPE: Machine
#@NAME: bananapi-ai2h machine
#@DESCRIPTION: RZ/V2H Development Board platform

require conf/machine/include/arm/armv8-2a/tune-cortexa55.inc
require conf/machine/include/rz-common.inc
require conf/machine/include/rzv2h-family.inc
require conf/machine/include/bananapi-common.inc

SERIAL_CONSOLES ?= "115200;ttySC0"
PREFERRED_VERSION_trusted-firmware-a ?= "2.10%"
TFA_PLATFORM ?= "v2h"
TFA_BOARD ?= "evk_1"
TFA_UBOOT ?= "1"
TFA_BUILD_TARGET ?= "bl2 fip"
BL2_BOOT_TARGET ?= "spi mmc esd"
EXTRA_IMAGEDEPENDS += " firmware-pack"
MACHINE_EXTRA_RDEPENDS += " isp-modules-load video-hw-udev-rules"

BL2_BASE_ADDR ?= "0x08103000"
BL2_ADJUST_VMA ?= "0x08101E00"
FIP_ADJUST_VMA ?= "0x0"

UBOOT_CONFIG ??= "bananapi-ai2h"
UBOOT_CONFIG[bananapi-ai2h] = "bananapi_ai2h_defconfig"
PREFERRED_VERSION_u-boot ?= "2024.07%"

# flash writer
EXTRA_IMAGEDEPENDS += " flash-writer"

# firmware pack
EXTRA_IMAGEDEPENDS += " firmware-pack"

# Supported devicetree
KERNEL_DTBDEST ?= "${KERNEL_IMAGEDEST}/dtb/renesas"
KERNEL_DEVICETREE = " \
    renesas/bananapi-ai2h.dtb \
"

IMAGE_BOOT_FILES = " \
	bl2_bp_spi-${MACHINE}.bin \
	bl2_bp_spi-${MACHINE}.srec \
	bl2_bp_mmc-${MACHINE}.bin \
	bl2_bp_mmc-${MACHINE}.srec \
	fip-${MACHINE}.bin \
	fip-${MACHINE}.srec \
	Flash_Writer_SCIF_RZV2H_DEV_INTERNAL_MEMORY.mot \
"

# Wic image
WKS_FILE = "bananapi-rz-image-esd.wks"
do_image_wic[depends] += "firmware-pack:do_deploy"
```

## meta-bananapi/meta-renesas-bsp/conf/machine/bananapi-ai2n.conf
```bitbake
#@TYPE: Machine
#@NAME: bananapi-ai2n machine
#@DESCRIPTION: RZ/V2N Development Board platform

require conf/machine/include/rzv2n-family.inc
require conf/machine/include/arm/armv8-2a/tune-cortexa55.inc
require conf/machine/include/rz-common.inc
require conf/machine/include/bananapi-common.inc

SERIAL_CONSOLES ?= "115200;ttySC0"
PREFERRED_VERSION_trusted-firmware-a ?= "2.10%"
TFA_PLATFORM ?= "v2n"
TFA_BOARD ?= "evk_1"
TFA_UBOOT ?= "1"
TFA_BUILD_TARGET ?= "bl2 fip"
BL2_BOOT_TARGET ?= "spi mmc esd"
EXTRA_IMAGEDEPENDS += " firmware-pack"
MACHINE_EXTRA_RDEPENDS += " isp-modules-load video-hw-udev-rules"

BL2_BASE_ADDR ?= "0x08103000"
BL2_ADJUST_VMA ?= "0x08101E00"
FIP_ADJUST_VMA ?= "0x0"

# U-Boot Configuration
PREFERRED_VERSION_u-boot ?= "2024.07%"
UBOOT_CONFIG ??= "bananapi-ai2n"
UBOOT_CONFIG[bananapi-ai2n] = "bananapi_ai2n_defconfig"

# flash writer
EXTRA_IMAGEDEPENDS += " flash-writer"

# firmware pack
EXTRA_IMAGEDEPENDS += " firmware-pack"

# Supported devicetree
KERNEL_DTBDEST ?= "${KERNEL_IMAGEDEST}/dtb/renesas"
KERNEL_DEVICETREE = " \
    renesas/bananapi-ai2n.dtb \
"

IMAGE_BOOT_FILES = " \
	bl2_bp_spi-${MACHINE}.bin \
	bl2_bp_spi-${MACHINE}.srec \
	bl2_bp_mmc-${MACHINE}.bin \
	bl2_bp_mmc-${MACHINE}.srec \
	fip-${MACHINE}.bin \
	fip-${MACHINE}.srec \
	Flash_Writer_SCIF_RZV2N_DEV_LPDDR4X.mot \
"

# Wic image
WKS_FILE = "bananapi-rz-image-esd.wks"
do_image_wic[depends] += "firmware-pack:do_deploy"
```

## meta-bananapi/meta-renesas-bsp/conf/machine/bananapi-g3l.conf
```bitbake
#@TYPE: Machine
#@NAME: bananapi-g3l
#@DESCRIPTION: Bananapi RZ/G3L platform

require conf/machine/include/arm/armv8-2a/tune-cortexa55.inc
require conf/machine/include/rz-common.inc
require conf/machine/include/rzg3l-family.inc
require conf/machine/include/bananapi-common.inc

MACHINE_FEATURES:append = " alsa ext2 pci serial usbgadget usbhost can"

SERIAL_CONSOLES ?= "115200;ttySC3"
PREFERRED_VERSION_trusted-firmware-a ?= "2.10%"
TFA_PLATFORM ?= "g3l"
TFA_BOARD ?= "smarc"
TFA_UBOOT ?= "1"
TFA_BUILD_TARGET ?= "bl2 fip"
BL2_BOOT_TARGET ?= "spi mmc esd"
BL2_BASE_ADDR ?= "0x23000"
BL2_ADJUST_VMA ?= "0x21E00"
FIP_ADJUST_VMA ?= "0x0000"
EXTRA_IMAGEDEPENDS += "firmware-pack"
MACHINE_EXTRA_RDEPENDS += " video-hw-udev-rules"

PREFERRED_VERSION_u-boot ?= "2024.07%"
UBOOT_CONFIG ??= "bananapi-g3l"
UBOOT_CONFIG[bananapi-g3l] = "bananapi_g3l_defconfig"

KERNEL_IMAGETYPE ?= "Image"
KERNEL_DTBDEST ?= "${KERNEL_IMAGEDEST}/dtb/renesas"
KERNEL_DEVICETREE ?= "renesas/bananapi-g3l.dtb"

IMAGE_BOOT_FILES = " \
    bl2_bp_spi-${MACHINE}.bin \
    bl2_bp_spi-${MACHINE}.srec \
    bl2_bp_mmc-${MACHINE}.bin \
    bl2_bp_mmc-${MACHINE}.srec \
    bl2_bp_esd-${MACHINE}.bin \
    bl2_bp_esd-${MACHINE}.srec \
    fip-${MACHINE}.bin \
    fip-${MACHINE}.srec \
    Flash_Writer_SCIF_RZG3L_SMARC_LPDDR4.mot \
"

WKS_FILE = "bananapi-rz-image-esd.wks"
do_image_wic[depends] += "firmware-pack:do_deploy flash-writer:do_deploy"
```

## meta-bananapi/meta-renesas-bsp/conf/machine/include/bananapi-common.inc
```bitbake
UBOOT_ARCH ?= "arm64"

ROOTFS_POSTPROCESS_COMMAND += "copy_boot_files_to_rootfs;"

copy_boot_files_to_rootfs() {
    install -d ${IMAGE_ROOTFS}/boot
    for f in ${IMAGE_BOOT_FILES}; do
        src=$(echo $f | cut -d';' -f1)
        dst=$(echo $f | cut -s -d';' -f2)
        [ -z "$dst" ] && dst=$(basename $src)
        if [ -f "${DEPLOY_DIR_IMAGE}/${src}" ]; then
            install -m 0644 "${DEPLOY_DIR_IMAGE}/${src}" "${IMAGE_ROOTFS}/boot/${dst}"
        elif [ -f "${DEPLOY_DIR_IMAGE}/${MACHINE}/${src}" ]; then
            install -m 0644 "${DEPLOY_DIR_IMAGE}/${MACHINE}/${src}" "${IMAGE_ROOTFS}/boot/${dst}"
        else
            bbwarn "Boot file $src not found"
        fi
    done
}
```
